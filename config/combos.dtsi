/*                                      PNCATEHO KEY MATRIX / LAYOUT MAPPING

  ╭────────────────────╮ ╭─────────────────────╮
  │  0   1   2   3     │ │ LT3 LT2 LT1 LT0     │
  │  4   5   6   7     │ │ LB3 LB2 LB1 LB0     │
  ╰──────────╮   8   9 │ ╰───────────╮ LH1 LH0 │
             ╰─────────╯             ╰─────────╯             */

#include "zmk-helpers/helper.h"
#include "zmk-helpers/key-labels/pncateho_macropad.h"

#define COMBO_TERM_FAST 18
#define COMBO_TERM_SLOW 30

#define COMBO_IDLE_FAST 150
#define COMBO_IDLE_SLOW 50

ZMK_COMBO(cm_enter,
    &kp ENTER,
    LT0 LB0,
    0)

ZMK_COMBO(cm_ctrlZ,
    &kp LC(Z),
    LT3 LB3,
    0)

ZMK_COMBO(cm_ctrlX,
    &kp LC(X),
    LB3 LB2,
    0)

ZMK_COMBO(cm_ctrlC,
    &kp LC(C),
    LB2 LB1,
    0)

ZMK_COMBO(cm_ctrlV,
    &kp LC(V),
    LB1 LB0,
    0)
    
ZMK_COMBO(cm_ctrlESC,
    &kp ESC,
    LT3 LT2,
    0)

ZMK_COMBO(cm_ctrlTab,
    &kp LC(TAB),
    LT1 LT0,
    0)

ZMK_COMBO(cm_ctrlF4,
    &kp LC(F4),
    LT1 LT0,
    0)    